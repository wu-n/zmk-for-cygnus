## config/boards/shields/cygnus/Kconfig.shield
```kconfig
# Copyright (c) 2020 The ZMK Contributors
# SPDX-License-Identifier: MIT

config SHIELD_TANK_CENTRAL_DONGLE
    def_bool $(shields_list_contains,tank_central_dongle)

config SHIELD_TANK_CENTRAL_LEFT
    def_bool $(shields_list_contains,tank_central_left)
    
config SHIELD_TANK_PERIPHERAL_LEFT
    def_bool $(shields_list_contains,tank_peripheral_left)

config SHIELD_TANK_PERIPHERAL_RIGHT
    def_bool $(shields_list_contains,tank_peripheral_right)
```
